AUTOSAR XML (schema 00046)
package /SWCs_EABS_PACKAGE
  sensor actuator sw component type LIDAR_SWC1
  sensor actuator sw component type SPEED_SENSOR_SWC2
  ecu abstraction sw component type IO_ABSTRACTION_SWC3
  application sw component type EABS_SWC4
  parameter sw component type P_d_SWC5
  sensor actuator sw component type LED_WARNING_SWC6
  complex device driver sw component type BRAKE_CDD_SWC7
  service sw component type DIAGMANEGER_SERVICE_SWC8
  nv block sw component type FLASH_NVBLOCK_SWC9
