AUTOSAR XML (schema 00046)
package /SR_Interfaces_Lab
  sender receiver interface Lidar_SRI
    data Lidar_objectDistance: type=uint16, init-value=8
    data Lidar_objectAngel: type=uint32, init-value=90
    data Lidar_objectID: type=uint16, init-value=100
  sensor actuator sw component type Lidar_Sensor_SWC
    provide port Pport_Lidar: provided-interface=Lidar_SRI
  application sw component type Lidar_Algo_SWC
    require port Rport_Lidar: required-interface=Lidar_SRI
