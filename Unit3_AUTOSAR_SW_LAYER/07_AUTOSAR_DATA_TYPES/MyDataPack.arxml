AUTOSAR XML (schema 00046)
standard types defined: uint8
package /myDataPack
  physical dimension Distance_in_meters: length-exp=1
  unit meters: factor-si-to-unit=1, physical-dimension=Distance_in_meters
  compu method cm_meter: identical; unit meters
  app type MyMetersType: category=VALUE, compu-method=cm_meters
  application array data type MyMetersArrayType: category=ARRAY
    element element: category=VALUE, type=MyMetersType, array-size-semantics=FIXED-SIZE, max-number-of-elements=4
  application record data type MyPointType: category=STRUCTURE
    application record element X: category=VALUE, type=MyMetersType
    application record element Y: category=VALUE, type=MyMetersType
  base type My_sint8: category=FIXED_LENGTH, base-type-size=8, base-type-encoding=2C, mem-alignment=1, native-declaration=char
  base type My_uint8: category=FIXED_LENGTH, base-type-size=8, base-type-encoding=NONE, mem-alignment=1, native-declaration=unsigned char
  range DC_uint8: phys 0..255, raw 0..255
  data type mapping set Data_Type_Mapping: data-type-map{application-data-type=MyMetersType, implementation-data-type=uint8}
