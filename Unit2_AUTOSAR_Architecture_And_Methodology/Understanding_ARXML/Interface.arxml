AUTOSAR XML (schema 00046)
package /INTERFACE
  sender receiver interface SR_IF1
    data x: type=uint8
